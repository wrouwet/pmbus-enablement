## Kconfig
```
# SPDX-License-Identifier: Apache-2.0

mainmenu "FRDM-MCXA153 PMBus target"

config PMBUS_ADDRESS
	hex "PMBus target address (7-bit)"
	default 0x58
	range 0x08 0x77
	help
	  0x58 is the usual first PMBus address of a power supply; its FRU EEPROM would
	  sit at 0x50.

config PMBUS_UPDATE_PERIOD_MS
	int "Sensor reading period (ms)"
	default 200

config PMBUS_TICK_MS
	int "Device model tick (ms)"
	default 10
	help
	  How often the output sequencing (TON_*/TOFF_*), fault delays and retries, the
	  fan and the limits are evaluated. Writes from the host are evaluated at once.

config PMBUS_SMBUS_TIMEOUT_MS
	int "SMBus target timeout (ms)"
	default 30
	help
	  If a transaction makes no progress for this long, the target interface resets
	  and the transaction is dropped. SMBus requires devices to reset between 25 ms
	  and 35 ms of SCL held low.

config PMBUS_STORE_MIN_INTERVAL_MS
	int "Minimum time between flash writes for STORE_DEFAULT_ALL (ms)"
	default 5000
	help
	  Limits how fast a misbehaving or hostile bus host can wear out the flash.
	  A store inside the interval is delayed; the device reports BUSY meanwhile.

config PMBUS_STORE_MAX_PER_BOOT
	int "Flash writes allowed per boot for STORE_DEFAULT_ALL"
	default 64
	help
	  Further stores fail with STATUS_CML memory fault until the next reset. Stores
	  that change nothing don't count.

config PMBUS_SIM_KNOBS
	bool "Simulation knobs on the bus (MFR_SPECIFIC_00..03)"
	default y
	help
	  Lets a bus host set the simulated load, input voltage and fan failure, and
	  inject status bits. Useful on the bench; turn it off for a device that sits on a
	  shared bus, where any host could otherwise fake faults. The shell's knobs stay.

source "Kconfig.zephyr"
```

## prj.conf
```kconfig
# The PMBus target on LPI2C0.
CONFIG_I2C=y
CONFIG_I2C_TARGET=y

# Sensors: the P3T1755 on I3C0 and the die temperature through the ADC.
CONFIG_SENSOR=y
CONFIG_I3C=y
CONFIG_ADC=y

CONFIG_GPIO=y
CONFIG_HWINFO=y

# STORE_DEFAULT_ALL writes to the storage partition.
CONFIG_FLASH=y
CONFIG_FLASH_MAP=y
CONFIG_CRC=y

CONFIG_SHELL=y
CONFIG_LOG=y
CONFIG_LOG_MODE_MINIMAL=y
CONFIG_MAIN_STACK_SIZE=1536


# Hardening: a stack overflow faults at once (ARMv8-M stack limit registers) instead of
# silently corrupting memory. (Stack canaries would need an entropy source; this SoC has none
# in Zephyr, and a fixed canary is guessable.)
CONFIG_HW_STACK_PROTECTION=y
```

## src/main.c
```c
/*
 * FRDM-MCXA153 PMBus target: a simulated 54 V to 12 V converter at
 * CONFIG_PMBUS_ADDRESS on LPI2C0, with its temperatures read from the on-board P3T1755
 * (READ_TEMPERATURE_1) and the MCU die (READ_TEMPERATURE_2).
 *
 * LEDs: green while the output is on and no status bit is set, red while any status
 * bit is set, blue on PMBus traffic.
 *
 * SPDX-License-Identifier: Apache-2.0
 */

#include <stdio.h>

#include <zephyr/device.h>
#include <zephyr/drivers/gpio.h>
#include <zephyr/drivers/hwinfo.h>
#include <zephyr/drivers/sensor.h>
#include <zephyr/kernel.h>
#include <zephyr/logging/log.h>

#include <pmbus/pmbus.h>

#include "app.h"

LOG_MODULE_REGISTER(main, LOG_LEVEL_INF);

struct pmbus_device pmbus_dev;
struct temp_override temp_override[2];

static const struct device *const temp_dev[2] = {
	DEVICE_DT_GET_OR_NULL(DT_ALIAS(ambient_temp0)),
	DEVICE_DT_GET_OR_NULL(DT_ALIAS(die_temp0)),
};
static const enum sensor_channel temp_chan[2] = {
	SENSOR_CHAN_AMBIENT_TEMP,
	SENSOR_CHAN_DIE_TEMP,
};

static const struct gpio_dt_spec led_green = GPIO_DT_SPEC_GET(DT_NODELABEL(green_led), gpios);
static const struct gpio_dt_spec led_red = GPIO_DT_SPEC_GET(DT_NODELABEL(red_led), gpios);
static const struct gpio_dt_spec led_blue = GPIO_DT_SPEC_GET(DT_NODELABEL(blue_led), gpios);

static bool read_temp(int i, int32_t *mc)
{
	struct sensor_value v;

	if (temp_override[i].active) {
		*mc = temp_override[i].mc;
		return true;
	}
	if (temp_dev[i] == NULL || !device_is_ready(temp_dev[i]) ||
	    sensor_sample_fetch(temp_dev[i]) != 0 ||
	    sensor_channel_get(temp_dev[i], temp_chan[i], &v) != 0) {
		return false;
	}
	*mc = v.val1 * 1000 + v.val2 / 1000;
	return true;
}

/* MFR_SERIAL: the first 8 bytes of the chip's unique ID, in hex. */
static void make_serial(char *buf, size_t len)
{
	uint8_t id[8];
	ssize_t n = hwinfo_get_device_id(id, sizeof(id));

	buf[0] = '\0';
	for (ssize_t i = 0; i < n && (size_t)(2 * i + 2) < len; i++) {
		snprintf(&buf[2 * i], 3, "%02X", id[i]);
	}
}

int main(void)
{
	char serial[17];
	struct pmbus_sensors s = {0};
	uint32_t last_transactions = 0;
	uint32_t since_sensors = 0;
	int64_t last = k_uptime_get();
	unsigned int key;
	int ret;

	gpio_pin_configure_dt(&led_green, GPIO_OUTPUT_INACTIVE);
	gpio_pin_configure_dt(&led_red, GPIO_OUTPUT_INACTIVE);
	gpio_pin_configure_dt(&led_blue, GPIO_OUTPUT_INACTIVE);

	make_serial(serial, sizeof(serial));
	pmbus_device_init(&pmbus_dev, CONFIG_PMBUS_ADDRESS, &storage_device_ops, NULL,
			  DT_NODE_HAS_PROP(DT_PATH(zephyr_user), smbalert_gpios), serial);
	pmbus_dev.sim_knobs = IS_ENABLED(CONFIG_PMBUS_SIM_KNOBS);
	if (storage_init() != 0) {
		LOG_ERR("storage partition unreadable; using defaults");
	}
	pmbus_device_load_stored(&pmbus_dev);

	s.temp1_valid = read_temp(0, &s.temp1_mc);
	s.temp2_valid = read_temp(1, &s.temp2_mc);
	LOG_INF("temperature 1 (P3T1755): %s, temperature 2 (die): %s",
		s.temp1_valid ? "ok" : "missing", s.temp2_valid ? "ok" : "missing");
	pmbus_device_update(&pmbus_dev, &s);

	ret = pmbus_i2c_start();
	if (ret != 0) {
		gpio_pin_set_dt(&led_red, 1);
		return ret;
	}

	while (true) {
		k_msleep(CONFIG_PMBUS_TICK_MS);

		/* Output sequencing and fault timers run every tick, sensors less often. */
		int64_t now = k_uptime_get();
		uint32_t elapsed = (uint32_t)(now - last);
		bool fresh = false;

		last = now;
		since_sensors += elapsed;
		if (since_sensors >= CONFIG_PMBUS_UPDATE_PERIOD_MS) {
			since_sensors = 0;
			s.temp1_valid = read_temp(0, &s.temp1_mc);
			s.temp2_valid = read_temp(1, &s.temp2_mc);
			fresh = true;
		}

		key = irq_lock();
		if (fresh) {
			pmbus_dev.sensors = s;
		}
		pmbus_device_advance(&pmbus_dev, elapsed);
		bool on = pmbus_dev.output_on;
		/* Being off, busy or not power-good alone is not a fault. */
		bool flagged = (pmbus_device_status_word(&pmbus_dev) &
				~(PMBUS_SB_OFF | PMBUS_SB_BUSY | PMBUS_SW_POWER_GOOD_N)) != 0;
		uint32_t transactions = pmbus_dev.target.n_transactions;
		irq_unlock(key);

		gpio_pin_set_dt(&led_green, on && !flagged);
		gpio_pin_set_dt(&led_red, flagged);
		gpio_pin_set_dt(&led_blue, transactions != last_transactions);
		last_transactions = transactions;
	}
	return 0;
}
```

## src/shell_cmds.c
```c
/*
 * Shell commands on the debug UART for watching the device and steering the
 * simulation by hand.
 *
 * SPDX-License-Identifier: Apache-2.0
 */

#include <errno.h>
#include <stdlib.h>
#include <string.h>

#include <zephyr/kernel.h>
#include <zephyr/shell/shell.h>

#include <pmbus/pmbus.h>

#include "app.h"

/* Prints a milli-unit value as a decimal with three places. */
#define MILLI(v) ((v) < 0 ? "-" : ""), abs((v) / 1000), abs((v) % 1000)

/* What `pmbus status` prints, copied out under the lock (the device itself is large). */
struct snapshot {
	uint8_t addr;
	bool output_on, fault_off, power_good, current_limited, alert_pending;
	enum pmbus_output_state state;
	int32_t vin_mv, iin_ma, pin_mw, vout_mv, iout_ma, pout_mw, fan1_rpm;
	struct pmbus_sensors sensors;
	uint16_t status_word;
	uint8_t status[PMBUS_S_COUNT];
	uint32_t n_transactions, n_pec_errors, n_aborts;
};

static const char *const state_names[] = {
	[PMBUS_OUT_OFF] = "off",
	[PMBUS_OUT_TON_DELAY] = "TON_DELAY",
	[PMBUS_OUT_RISING] = "rising",
	[PMBUS_OUT_ON] = "on",
	[PMBUS_OUT_TOFF_DELAY] = "TOFF_DELAY",
	[PMBUS_OUT_FALLING] = "falling",
};

static int cmd_status(const struct shell *sh, size_t argc, char **argv)
{
	struct snapshot d;
	uint32_t timeouts;
	unsigned int key;

	ARG_UNUSED(argc);
	ARG_UNUSED(argv);

	key = irq_lock();
	d.addr = pmbus_dev.target.addr;
	d.output_on = pmbus_dev.output_on;
	d.fault_off = pmbus_dev.fault_off;
	d.power_good = pmbus_dev.power_good;
	d.current_limited = pmbus_dev.current_limited;
	d.alert_pending = pmbus_dev.alert_pending;
	d.state = pmbus_dev.out_state;
	d.vin_mv = pmbus_dev.vin_mv;
	d.iin_ma = pmbus_dev.iin_ma;
	d.pin_mw = pmbus_dev.pin_mw;
	d.vout_mv = pmbus_dev.vout_mv;
	d.iout_ma = pmbus_dev.iout_ma;
	d.pout_mw = pmbus_dev.pout_mw;
	d.fan1_rpm = pmbus_dev.fan1_rpm;
	d.sensors = pmbus_dev.sensors;
	d.status_word = pmbus_device_status_word(&pmbus_dev);
	memcpy(d.status, pmbus_dev.status, sizeof(d.status));
	d.n_transactions = pmbus_dev.target.n_transactions;
	d.n_pec_errors = pmbus_dev.target.n_pec_errors;
	d.n_aborts = pmbus_dev.target.n_aborts;
	irq_unlock(key);
	pmbus_i2c_stats(&timeouts);

	shell_print(sh, "address 0x%02x, output %s%s%s%s", d.addr, state_names[d.state],
		    d.fault_off ? " (latched off by a fault)" : "",
		    d.power_good ? ", power good" : "",
		    d.current_limited ? ", current limited" : "");
	shell_print(sh, "VIN  %s%d.%03d V   IIN  %s%d.%03d A   PIN  %s%d.%03d W", MILLI(d.vin_mv),
		    MILLI(d.iin_ma), MILLI(d.pin_mw));
	shell_print(sh, "VOUT %s%d.%03d V   IOUT %s%d.%03d A   POUT %s%d.%03d W",
		    MILLI(d.vout_mv), MILLI(d.iout_ma), MILLI(d.pout_mw));
	shell_print(sh, "TEMP1 %s%s%d.%03d C   TEMP2 %s%s%d.%03d C   FAN1 %d RPM",
		    d.sensors.temp1_valid ? "" : "(missing) ", MILLI(d.sensors.temp1_mc),
		    d.sensors.temp2_valid ? "" : "(missing) ", MILLI(d.sensors.temp2_mc),
		    (int)d.fan1_rpm);
	shell_print(sh, "STATUS_WORD 0x%04x  VOUT 0x%02x  IOUT 0x%02x  INPUT 0x%02x  "
		    "TEMPERATURE 0x%02x  CML 0x%02x  OTHER 0x%02x  FANS 0x%02x",
		    d.status_word, d.status[PMBUS_S_VOUT], d.status[PMBUS_S_IOUT],
		    d.status[PMBUS_S_INPUT], d.status[PMBUS_S_TEMPERATURE], d.status[PMBUS_S_CML],
		    d.status[PMBUS_S_OTHER], d.status[PMBUS_S_FANS_1_2]);
	shell_print(sh, "SMBALERT# %s, transactions %u, PEC errors %u, aborts %u, timeouts %u",
		    d.alert_pending ? "asserted" : "released", d.n_transactions, d.n_pec_errors,
		    d.n_aborts, timeouts);
	return 0;
}

/* Parses a whole decimal or 0x number; rejects junk and out-of-range values. */
static int parse_long(const struct shell *sh, const char *arg, long min, long max, long *out)
{
	char *end;
	long v;

	errno = 0;
	v = strtol(arg, &end, 0);
	if (errno != 0 || end == arg || *end != '\0' || v < min || v > max) {
		shell_error(sh, "'%s': expected a number from %ld to %ld", arg, min, max);
		return -EINVAL;
	}
	*out = v;
	return 0;
}

static int cmd_load(const struct shell *sh, size_t argc, char **argv)
{
	unsigned int key;
	long v;

	ARG_UNUSED(argc);
	if (parse_long(sh, argv[1], 0, 1000000, &v) != 0) {
		return -EINVAL;
	}
	key = irq_lock();
	pmbus_dev.sim.load_ma = (int32_t)v;
	pmbus_device_update(&pmbus_dev, NULL);
	irq_unlock(key);
	shell_print(sh, "load %s mA", argv[1]);
	return 0;
}

static int cmd_vin(const struct shell *sh, size_t argc, char **argv)
{
	unsigned int key;
	long v;

	ARG_UNUSED(argc);
	if (parse_long(sh, argv[1], 0, 1000000, &v) != 0) {
		return -EINVAL;
	}
	key = irq_lock();
	pmbus_dev.sim.vin_mv = (int32_t)v;
	pmbus_device_update(&pmbus_dev, NULL);
	irq_unlock(key);
	shell_print(sh, "VIN %s mV", argv[1]);
	return 0;
}

static int cmd_temp(const struct shell *sh, size_t argc, char **argv)
{
	long i, mc;

	ARG_UNUSED(argc);
	if (parse_long(sh, argv[1], 1, 2, &i) != 0) {
		return -EINVAL;
	}
	if (strcmp(argv[2], "off") == 0) {
		temp_override[i - 1].active = false;
		shell_print(sh, "temperature %ld: real sensor", i);
	} else {
		if (parse_long(sh, argv[2], -273000, 1000000, &mc) != 0) {
			return -EINVAL;
		}
		temp_override[i - 1].mc = (int32_t)mc;
		temp_override[i - 1].active = true;
		shell_print(sh, "temperature %ld: %s m°C until 'pmbus temp %ld off'", i, argv[2],
			    i);
	}
	return 0;
}

static int cmd_control(const struct shell *sh, size_t argc, char **argv)
{
	unsigned int key;
	long v;

	ARG_UNUSED(argc);
	if (parse_long(sh, argv[1], 0, 1, &v) != 0) {
		return -EINVAL;
	}
	key = irq_lock();
	pmbus_device_set_control_pin(&pmbus_dev, v != 0);
	irq_unlock(key);
	shell_print(sh, "CONTROL %s", argv[1]);
	return 0;
}

static int cmd_clear(const struct shell *sh, size_t argc, char **argv)
{
	unsigned int key = irq_lock();

	ARG_UNUSED(argc);
	ARG_UNUSED(argv);
	pmbus_device_clear_faults(&pmbus_dev);
	irq_unlock(key);
	shell_print(sh, "faults cleared");
	return 0;
}

static int cmd_fan(const struct shell *sh, size_t argc, char **argv)
{
	unsigned int key;

	ARG_UNUSED(argc);
	if (strcmp(argv[1], "fail") != 0 && strcmp(argv[1], "ok") != 0) {
		shell_error(sh, "fan fail|ok");
		return -EINVAL;
	}
	key = irq_lock();
	pmbus_dev.sim.fan1_failed = strcmp(argv[1], "fail") == 0;
	irq_unlock(key);
	shell_print(sh, "fan 1 %s", argv[1]);
	return 0;
}

static int cmd_inject(const struct shell *sh, size_t argc, char **argv)
{
	static const char *const names[PMBUS_S_COUNT] = {
		"vout", "iout", "input", "temperature", "cml", "other", "mfr", "fans",
	};
	unsigned int key;
	long bits;

	ARG_UNUSED(argc);
	if (parse_long(sh, argv[2], 1, 0xFF, &bits) != 0) {
		return -EINVAL;
	}
	for (int i = 0; i < PMBUS_S_COUNT; i++) {
		if (strcmp(argv[1], names[i]) == 0) {
			key = irq_lock();
			pmbus_device_inject(&pmbus_dev, (enum pmbus_status_reg)i, (uint8_t)bits);
			irq_unlock(key);
			shell_print(sh, "STATUS_%s |= 0x%02lx", names[i], bits);
			return 0;
		}
	}
	shell_error(sh, "register: vout iout input temperature cml other mfr fans");
	return -EINVAL;
}

SHELL_STATIC_SUBCMD_SET_CREATE(pmbus_cmds,
	SHELL_CMD(status, NULL, "Telemetry, status registers and counters", cmd_status),
	SHELL_CMD_ARG(load, NULL, "<mA>  Simulated load current", cmd_load, 2, 0),
	SHELL_CMD_ARG(vin, NULL, "<mV>  Simulated input voltage", cmd_vin, 2, 0),
	SHELL_CMD_ARG(temp, NULL, "<1|2> <m°C|off>  Override a temperature sensor",
		      cmd_temp, 3, 0),
	SHELL_CMD_ARG(control, NULL, "<0|1>  The CONTROL input (see ON_OFF_CONFIG)",
		      cmd_control, 2, 0),
	SHELL_CMD_ARG(fan, NULL, "<fail|ok>  Stop or restart the simulated fan", cmd_fan, 2, 0),
	SHELL_CMD_ARG(inject, NULL, "<register> <bits>  Latch status bits (alert testing)",
		      cmd_inject, 3, 0),
	SHELL_CMD(clear, NULL, "CLEAR_FAULTS", cmd_clear),
	SHELL_SUBCMD_SET_END);

SHELL_CMD_REGISTER(pmbus, &pmbus_cmds, "PMBus target", NULL);
```

## src/storage.c
```c
/*
 * STORE_DEFAULT_ALL and RESTORE_DEFAULT_ALL, backed by the storage partition.
 *
 * One record lives at the start of the partition. A RAM copy answers
 * RESTORE_DEFAULT_ALL straight from the I2C interrupt; a work item does the flash
 * erase and write that STORE_DEFAULT_ALL asks for.
 *
 * Any bus host may send STORE_DEFAULT_ALL (PMBus has no authentication, and
 * WRITE_PROTECT can be cleared by anyone), and flash survives a limited number of
 * erases. So a store that changes nothing writes nothing, flash writes are spaced at
 * least CONFIG_PMBUS_STORE_MIN_INTERVAL_MS apart (the device stays BUSY meanwhile), and
 * after CONFIG_PMBUS_STORE_MAX_PER_BOOT writes further stores fail with a memory fault
 * until the next reset.
 *
 * SPDX-License-Identifier: Apache-2.0
 */

#include <string.h>

#include <zephyr/kernel.h>
#include <zephyr/logging/log.h>
#include <zephyr/storage/flash_map.h>
#include <zephyr/sys/crc.h>

#include "app.h"

LOG_MODULE_REGISTER(storage, LOG_LEVEL_INF);

#define STORAGE_ID   PARTITION_ID(storage_partition)
#define RECORD_MAGIC 0x504d4231 /* "PMB1" */

struct record {
	uint32_t magic;
	struct pmbus_device_config cfg;
	uint32_t crc;
};

/* Flash writes go in 16-byte phrases. */
#define RECORD_SIZE ROUND_UP(sizeof(struct record), 16)

static union {
	struct record r;
	uint8_t raw[RECORD_SIZE];
} __aligned(4) shadow, pending;

static bool shadow_valid;
static uint32_t n_writes;
static int64_t last_write_ms = -CONFIG_PMBUS_STORE_MIN_INTERVAL_MS;

static uint32_t record_crc(const struct record *r)
{
	return crc32_ieee((const uint8_t *)r, offsetof(struct record, crc));
}

int storage_init(void)
{
	const struct flash_area *fa;
	int ret = flash_area_open(STORAGE_ID, &fa);

	if (ret != 0) {
		return ret;
	}
	ret = flash_area_read(fa, 0, shadow.raw, sizeof(shadow.raw));
	flash_area_close(fa);
	if (ret != 0) {
		return ret;
	}
	shadow_valid = shadow.r.magic == RECORD_MAGIC && shadow.r.crc == record_crc(&shadow.r);
	LOG_INF("stored config: %s", shadow_valid ? "found" : "none");
	return 0;
}

static void store_work_fn(struct k_work *work)
{
	const struct flash_area *fa;
	unsigned int key;
	bool ok = false;

	ARG_UNUSED(work);

	if (flash_area_open(STORAGE_ID, &fa) == 0) {
		ok = flash_area_flatten(fa, 0, fa->fa_size) == 0 &&
		     flash_area_write(fa, 0, pending.raw, sizeof(pending.raw)) == 0;
		flash_area_close(fa);
	}
	n_writes++;
	last_write_ms = k_uptime_get();
	key = irq_lock();
	if (ok) {
		shadow = pending;
		shadow_valid = true;
	}
	pmbus_device_store_done(&pmbus_dev, ok);
	irq_unlock(key);
	LOG_INF("STORE_DEFAULT_ALL %s (%u this boot)", ok ? "done" : "failed", n_writes);
}

static K_WORK_DELAYABLE_DEFINE(store_work, store_work_fn);

static void set_alert(void *ctx, bool asserted)
{
	ARG_UNUSED(ctx);
	pmbus_i2c_set_alert(asserted);
}

/* Called from the I2C interrupt. */
static void store(void *ctx, const struct pmbus_device_config *cfg)
{
	ARG_UNUSED(ctx);
	/* Nothing new to store: done, without touching flash. */
	if (shadow_valid && memcmp(&shadow.r.cfg, cfg, sizeof(*cfg)) == 0) {
		pmbus_device_store_done(&pmbus_dev, true);
		return;
	}
	if (n_writes >= CONFIG_PMBUS_STORE_MAX_PER_BOOT) {
		pmbus_device_store_done(&pmbus_dev, false);
		return;
	}
	/* The device refuses a second store while BUSY, so pending is ours until done. */
	memset(&pending, 0xFF, sizeof(pending));
	pending.r.magic = RECORD_MAGIC;
	memcpy(&pending.r.cfg, cfg, sizeof(*cfg));
	pending.r.crc = record_crc(&pending.r);

	int64_t wait = last_write_ms + CONFIG_PMBUS_STORE_MIN_INTERVAL_MS - k_uptime_get();

	k_work_schedule(&store_work, K_MSEC(wait > 0 ? wait : 0));
}

/* The device validates what it gets (pmbus_device_config_valid()) before using it. */
static bool restore(void *ctx, struct pmbus_device_config *cfg)
{
	ARG_UNUSED(ctx);
	if (!shadow_valid) {
		return false;
	}
	memcpy(cfg, &shadow.r.cfg, sizeof(*cfg));
	return true;
}

const struct pmbus_device_ops storage_device_ops = {
	.set_alert = set_alert,
	.store = store,
	.restore = restore,
};
```
